## conf/distro/include/buildinfo.inc
```bitbake
# /********************************************************************************
# * Copyright (c) 2022 Contributors to the Eclipse Foundation
# *
# * See the NOTICE file(s) distributed with this work for additional
# * information regarding copyright ownership.
# *
# * This program and the accompanying materials are made available under the
# * terms of the Apache License 2.0 which is available at
# * https://www.apache.org/licenses/LICENSE-2.0
# *
# * SPDX-License-Identifier: Apache-2.0
# ********************************************************************************/

# Create the /etc/build file
INHERIT += "image-buildinfo"
IMAGE_BUILDINFO_VARS:append = " DATETIME DISTRO_NAME IMAGE_BASENAME MACHINE TUNE_PKGARCH" 
IMAGE_BUILDINFO_VARS:append = " MACHINE_FEATURES DISTRO_FEATURES COMMON_FEATURES IMAGE_FEATURES"
IMAGE_BUILDINFO_VARS:append = " TUNE_FEATURES TARGET_FPU"
IMAGE_BUILDINFO_VARS:append = " APP_URI_PREFIX APP_URI_BRANCH"
```

## conf/distro/include/kastro-qemu-settings.inc
```bitbake
# Increase memory for k3s to at least 2GB or more
QB_MEM = "-m 4096"

# No graphical user interface
QB_OPT_APPEND:append = " -serial mon:stdio -serial null -nographic"

# Emulate a CAN-Bus device
QB_OPT_APPEND:append = " -object can-bus,id=canbus0 "
QB_OPT_APPEND:append = " -device kvaser_pci,canbus=canbus0"

QB_DEFAULT_FSTYPE = "ext4"
```

## conf/distro/kastro.conf
```bitbake
# /********************************************************************************
# * Copyright (c) 2022 Contributors to the Eclipse Foundation
# *
# * See the NOTICE file(s) distributed with this work for additional
# * information regarding copyright ownership.
# *
# * This program and the accompanying materials are made available under the
# * terms of the Apache License 2.0 which is available at
# * https://www.apache.org/licenses/LICENSE-2.0
# *
# * SPDX-License-Identifier: Apache-2.0
# ********************************************************************************/

require conf/distro/poky.conf 

require conf/distro/include/buildinfo.inc
require conf/distro/include/kastro-distro-features.inc
#require conf/distro/include/kastro-install-packages.inc
require conf/distro/include/kastro-selfupdate-rauc.inc
require conf/distro/include/kastro-qemu-settings.inc

DISTRO = "kastro"
DISTRO_NAME="Eclipse Kastro"
DISTRO_VERSION="2022"
DISTRO_CODENAME="Hockenheim"

MAINTAINER = "Mike Haller <mike.haller@bosch.com>"

# Ensure timestamp of rootfs and kernel are updated (non-reproducable-build)
BUILD_REPRODUCIBLE_BINARIES = "0"
REPRODUCIBLE_TIMESTAMP_ROOTFS = ""
```

## conf/layer.conf
```bitbake
# /********************************************************************************
# * Copyright (c) 2022 Contributors to the Eclipse Foundation
# *
# * See the NOTICE file(s) distributed with this work for additional
# * information regarding copyright ownership.
# *
# * This program and the accompanying materials are made available under the
# * terms of the Apache License 2.0 which is available at
# * https://www.apache.org/licenses/LICENSE-2.0
# *
# * SPDX-License-Identifier: Apache-2.0
# ********************************************************************************/

# We have a conf and classes directory, add to BBPATH
BBPATH .= ":${LAYERDIR}"

# We have recipes-* directories, add to BBFILES
BBFILES += "${LAYERDIR}/recipes-*/*/*.bb \
            ${LAYERDIR}/recipes-*/*/*.bbappend"

BBFILE_COLLECTIONS += "meta-sdv"
BBFILE_PATTERN_meta-sdv := "^${LAYERDIR}/"
BBFILE_PRIORITY_meta-sdv = "7"
LAYERDEPENDS_meta-sdv += "core meta-sdv-bsp meta-sdv-components meta-sdv-distro"
LAYERSERIES_COMPAT_meta-sdv = "honister"
```

## conf/machine/common-qemu-arm.inc
```bitbake
EXTRA_IMAGEDEPENDS += "u-boot"
do_image_wic[depends] += "mtools-native:do_populate_sysroot dosfstools-native:do_populate_sysroot virtual/bootloader:do_deploy"

#SERIAL_CONSOLES = "115200;ttyS0"

KERNEL_IMAGETYPE = "Image"
KERNEL_EXTRA_ARGS += "LOADADDR=${UBOOT_ENTRYPOINT}"

UBOOT_SUFFIX = "bin"
UBOOT_ENTRYPOINT = "0x80008000"
UBOOT_LOADADDRESS = "0x80008000"

MACHINE_FEATURES = "usbgadget usbhost vfat"

IMAGE_BOOT_FILES = "u-boot.${UBOOT_SUFFIX} ${KERNEL_IMAGETYPE}"
IMAGE_CLASSES += "qemuboot"

QB_DEFAULT_BIOS = "u-boot.bin"
```

## conf/machine/qemuarm-extra.conf
```bitbake
#@TYPE: Machine
#@NAME: qemuarm machine
#@DESCRIPTION: Reference machine configuration for qemu

MACHINE_EXTRA_RRECOMMENDS = "kernel-modules kernel-devicetree"
EXTRA_IMAGEDEPENDS += "u-boot"
WKS_FILES = "qemuarm.wks"
#IMAGE_INSTALL:append = " kernel-devicetree kernel-image-zimage"
do_image_wic[depends] += "mtools-native:do_populate_sysroot dosfstools-native:do_populate_sysroot"

#SERIAL_CONSOLES = "115200;ttyO0"
#PREFERRED_PROVIDER_virtual/kernel ?= "linux-yocto"
#PREFERRED_VERSION_linux-yocto ?= "4.12%"
#KERNEL_IMAGETYPE = "zImage"
#KERNEL_DEVICETREE = "am335x-bone.dtb am335x-boneblack.dtb am335x-bonegreen.dtb"
#KERNEL_DEVICETREE = "virt"
#KERNEL_EXTRA_ARGS += "LOADADDR=${UBOOT_ENTRYPOINT}"

#SPL_BINARY = "MLO"
#UBOOT_SUFFIX = "img"
#UBOOT_MACHINE = "am335x_boneblack_config"
#UBOOT_MACHINE = "qemu_arm_defconfig"
#UBOOT_ENTRYPOINT = "0x80008000"
#UBOOT_LOADADDRESS = "0x80008000"
#MACHINE_FEATURES = "usbgadget usbhost vfat alsa"

#IMAGE_BOOT_FILES ?= "u-boot.${UBOOT_SUFFIX} MLO"
IMAGE_BOOT_FILES ?= "u-boot.${UBOOT_SUFFIX} boot.cmd ${SPL_BINARY} ${KERNEL_IMAGETYPE} ${KERNEL_DEVICETREE}"

QB_DEFAULT_BIOS = "u-boot.bin"
```

## conf/machine/qemuarm64-extra.conf
```bitbake
#@TYPE: Machine
#@NAME: qemuarm64 machine
#@DESCRIPTION: Reference machine configuration for qemu arm64

require conf/machine/common-qemu-arm.inc

WKS_FILES = "qemuarm64.wks"
UBOOT_MACHINE = "qemu_arm64_defconfig"
```

## conf/machine/qemuarm64.conf
```bitbake
#@TYPE: Machine
#@NAME: qemuarm64 machine
#@DESCRIPTION: Reference machine configuration for qemu

MACHINE_EXTRA_RRECOMMENDS = "kernel-modules kernel-devicetree"

EXTRA_IMAGEDEPENDS += "u-boot"

#DEFAULTTUNE ?= "cortexa8hf-neon"
#include conf/machine/include/tune-cortexa8.inc

#IMAGE_FSTYPES += "tar.bz2 jffs2 wic wic.bmap"
#EXTRA_IMAGECMD_jffs2 = "-lnp "
#WKS_FILE ?= "beaglebone-yocto.wks"
WKS_FILES = "qemuarm64.wks"

IMAGE_INSTALL_append = " kernel-devicetree kernel-image-zimage"
do_image_wic[depends] += "mtools-native:do_populate_sysroot dosfstools-native:do_populate_sysroot"

SERIAL_CONSOLES = "115200;ttyO0"

#PREFERRED_PROVIDER_virtual/kernel ?= "linux-yocto"
#PREFERRED_VERSION_linux-yocto ?= "4.12%"

KERNEL_IMAGETYPE = "zImage"
#KERNEL_DEVICETREE = "am335x-bone.dtb am335x-boneblack.dtb am335x-bonegreen.dtb"
KERNEL_DEVICETREE = "virt"
KERNEL_EXTRA_ARGS += "LOADADDR=${UBOOT_ENTRYPOINT}"

SPL_BINARY = "MLO"
UBOOT_SUFFIX = "img"
#UBOOT_MACHINE = "am335x_boneblack_config"
UBOOT_MACHINE = "qemu_arm64_defconfig"
UBOOT_ENTRYPOINT = "0x80008000"
UBOOT_LOADADDRESS = "0x80008000"

MACHINE_FEATURES = "usbgadget usbhost vfat alsa"

#IMAGE_BOOT_FILES ?= "u-boot.${UBOOT_SUFFIX} MLO"
IMAGE_BOOT_FILES ?= "u-boot.${UBOOT_SUFFIX} boot.cmd ${SPL_BINARY} ${KERNEL_IMAGETYPE} ${KERNEL_DEVICETREE}"
```

## conf/machine/raspberrypi4-64-extra.conf
```bitbake
#@TYPE: Machine
#@NAME: raspberrypi4-64 machine
#@DESCRIPTION: Reference machine configuration for Raspberry Pi4

# From meta-raspberrypi

#MACHINE_EXTRA_RRECOMMENDS = "kernel-modules kernel-devicetree"
#EXTRA_IMAGEDEPENDS += "u-boot"

WKS_FILES = "raspberrypi.wks.in"

#IMAGE_INSTALL:append = " kernel-devicetree kernel-image-zimage"
#do_image_wic[depends] += "mtools-native:do_populate_sysroot dosfstools-native:do_populate_sysroot"

#SERIAL_CONSOLES = "115200;ttyO0"

#PREFERRED_PROVIDER_virtual/kernel ?= "linux-yocto"
#PREFERRED_VERSION_linux-yocto ?= "4.12%"

#KERNEL_IMAGETYPE = "zImage"
#KERNEL_DEVICETREE = "am335x-bone.dtb am335x-boneblack.dtb am335x-bonegreen.dtb"
#KERNEL_DEVICETREE = "virt"
#KERNEL_EXTRA_ARGS += "LOADADDR=${UBOOT_ENTRYPOINT}"

#SPL_BINARY = "MLO"
#UBOOT_SUFFIX = "img"
#UBOOT_MACHINE = "am335x_boneblack_config"
#UBOOT_MACHINE = "qemu_arm_defconfig"
#UBOOT_ENTRYPOINT = "0x80008000"
#UBOOT_LOADADDRESS = "0x80008000"

#MACHINE_FEATURES = "usbgadget usbhost vfat alsa"

#IMAGE_BOOT_FILES ?= "u-boot.${UBOOT_SUFFIX} MLO"
IMAGE_BOOT_FILES ?= "u-boot.${UBOOT_SUFFIX} boot.cmd ${SPL_BINARY} ${KERNEL_IMAGETYPE} ${KERNEL_DEVICETREE}"

#QB_DEFAULT_BIOS = "u-boot.bin"

# Raspberry-Specific
#IMAGE_FSTYPES += "tar.bz2 ext4 wic.bz2 wic.bmap"

# Allow the root partition to grow to the size of the SD Card on the Raspi
IMAGE_INSTALL:append = " e2fsprogs-resize2fs"
IMAGE_INSTALL:append = " parted"

# Enable single-chip CAN extension based on MCP251x
ENABLE_SPI_BUS = "1"
ENABLE_CAN = "1"

# If you have dual-chip CAN extensions, use this:
#ENABLE_DUAL_CAN = "1"

# Frequency of the crystal oscillator on the CAN extension. Default is 16 Mhz
# For Pican2 (16 MHz)
# For PiCAN2 Duo (16 MHz crystal)
#CAN_OSCILLATOR="16000000"

# For WaveShare RS485 CAN HAT (12MHz or 8MHz)
#CAN_OSCILLATOR="12000000"

# For WaveShare RS485 CAN HAT (12MHz or 8MHz)
#CAN_OSCILLATOR="8000000"

# Enable UART
ENABLE_UART = "1"

# Images
RPI_USE_U_BOOT = "1"
```

## meta-leda-backports/conf/layer.conf
```bitbake
# /********************************************************************************
# * Copyright (c) 2022 Contributors to the Eclipse Foundation
# *
# * See the NOTICE file(s) distributed with this work for additional
# * information regarding copyright ownership.
# *
# * This program and the accompanying materials are made available under the
# * terms of the Apache License 2.0 which is available at
# * https://www.apache.org/licenses/LICENSE-2.0
# *
# * SPDX-License-Identifier: Apache-2.0
# ********************************************************************************/

# We have a conf and classes directory, add to BBPATH
BBPATH .= ":${LAYERDIR}"

# We have recipes-* directories, add to BBFILES
BBFILES += "${LAYERDIR}/recipes-*/*/*.bb \
            ${LAYERDIR}/recipes-*/*/*.bbappend"

BBFILE_COLLECTIONS += "meta-leda-backports"
BBFILE_PATTERN_meta-leda-backports := "^${LAYERDIR}/"
BBFILE_PRIORITY_meta-leda-backports = "7"

LAYERSERIES_COMPAT_meta-leda-backports = "kirkstone"
```

## meta-leda-bsp/conf/machine/common-qemu-arm.inc
```bitbake
# /********************************************************************************
# * Copyright (c) 2022 Contributors to the Eclipse Foundation
# *
# * See the NOTICE file(s) distributed with this work for additional
# * information regarding copyright ownership.
# *
# * This program and the accompanying materials are made available under the
# * terms of the Apache License 2.0 which is available at
# * https://www.apache.org/licenses/LICENSE-2.0
# *
# * SPDX-License-Identifier: Apache-2.0
# ********************************************************************************/

EXTRA_IMAGEDEPENDS += "u-boot"
do_image_wic[depends] += "mtools-native:do_populate_sysroot dosfstools-native:do_populate_sysroot virtual/bootloader:do_deploy"

# Ensure that U-Boot is using the boot script instead of extern Linux Kernel directly
UBOOT_EXTLINUX = "0"

#SERIAL_CONSOLES = "115200;ttyS0"

KERNEL_IMAGETYPE = "Image"
KERNEL_EXTRA_ARGS += "LOADADDR=${UBOOT_ENTRYPOINT}"

UBOOT_SUFFIX = "bin"
KERNEL_BOOTCMD = "booti"
UBOOT_ENTRYPOINT = "0x40008000"
UBOOT_LOADADDRESS = "0x40008000"

UBOOT_ENV = "boot"
UBOOT_ENV_SUFFIX = "scr"

# Output of U-Boot's "bdinfo" command on qemu-system-arm:
# boot_params = 0x00000000
# DRAM bank   = 0x00000000
# -> start    = 0x40000000              = 1073741824 dec = 1 GiB
# -> size     = 0x80000000              = 2147483648 dec = 2 GiB
# flashstart  = 0x00000000
# flashsize   = 0x04000000              =   67108864 dec = 64 MiB
# flashoffset = 0x000a9878              =     694392 dec = 678 KiB

MACHINE_FEATURES = "usbgadget usbhost vfat"

IMAGE_BOOT_FILES = "u-boot.${UBOOT_SUFFIX} ${KERNEL_IMAGETYPE} ${UBOOT_ENV}.${UBOOT_ENV_SUFFIX}"
IMAGE_CLASSES += "qemuboot"

QB_DEFAULT_BIOS = "u-boot.bin"
```

## meta-leda-bsp/conf/machine/containerx86_64.conf
```bitbake
#@TYPE: Machine
#@NAME: containerx86_64
#@DESCRIPTION: A virtual machine defition for x86_64 OCI containers

require conf/machine/qemux86_64
PREFERRED_PROVIDER_virtual/kernel = "linux-dummy"
MACHINE_ESSENTIAL_EXTRA_RDEPENDS = ""
```

## meta-leda-bsp/conf/machine/qemuarm-extra.conf
```bitbake
#@TYPE: Machine
#@NAME: qemuarm machine
#@DESCRIPTION: Reference machine configuration for qemu

require conf/machine/common-qemu-arm.inc

WKS_FILES = "qemuarm.wks"
UBOOT_MACHINE = "qemu_arm_defconfig"
KERNEL_IMAGETYPE = "zImage"
KERNEL_BOOTCMD = "bootz"
```

## meta-leda-bsp/conf/machine/qemux86-64-extra.conf
```bitbake
#@TYPE: Machine
#@NAME: QEMU x86-64 machine
#@DESCRIPTION: Machine configuration for running an x86-64 system on QEMU with EFI

KERNEL_IMAGETYPE = "bzImage"
IMAGE_BOOT_FILES = " bootx64.efi;EFI/BOOT/bootx64.efi ${UBOOT_ENV}.${UBOOT_ENV_SUFFIX}"
SERIAL_CONSOLES ?= "115200;ttyS0 115200;ttyS1"
MACHINE_FEATURES += "x86 pci pcbios efi"
MACHINE_ESSENTIAL_EXTRA_RDEPENDS += "v86d"
WKS_FILE = "qemux86-64-uboot-efi.wks"
do_image_wic[depends] += "syslinux:do_populate_sysroot syslinux-native:do_populate_sysroot mtools-native:do_populate_sysroot dosfstools-native:do_populate_sysroot"
EXTRA_IMAGEDEPENDS += "ovmf u-boot"

UBOOT_ENV = "boot"
UBOOT_ENV_SUFFIX = "scr"
UBOOT_EXTLINUX = "0"
UBOOT_MACHINE = "efi-x86_payload64_defconfig"
KERNEL_BOOTCMD = "zboot"
PREFERRED_PROVIDER_virtual/bootloader = "u-boot"
```

## meta-leda-bsp/conf/machine/raspberrypi4-64-extra.conf
```bitbake
#@TYPE: Machine
#@NAME: raspberrypi4-64 machine
#@DESCRIPTION: Reference machine configuration for Raspberry Pi4

WKS_FILES = "raspberrypi.wks.in"

UBOOT_SUFFIX = "bin"

IMAGE_FSTYPES = "tar.bz2 ext4"

# Allow the root partition to grow to the size of the SD Card on the Raspi
IMAGE_INSTALL:append = " e2fsprogs-resize2fs"
IMAGE_INSTALL:append = " gptfdisk"
IMAGE_INSTALL:append = " sdv-raspberry-growdisk"

# Enable single-chip CAN extension based on MCP251x
ENABLE_SPI_BUS = "1"
ENABLE_CAN = "1"

# If you have dual-chip CAN extensions, use this:
#ENABLE_DUAL_CAN = "1"

# Frequency of the crystal oscillator on the CAN extension. Default is 16 Mhz
# For Pican2 (16 MHz)
# For PiCAN2 Duo (16 MHz crystal)
#CAN_OSCILLATOR="16000000"

# For WaveShare RS485 CAN HAT (12MHz or 8MHz)
#CAN_OSCILLATOR="12000000"

# For WaveShare RS485 CAN HAT (12MHz or 8MHz)
#CAN_OSCILLATOR="8000000"

# Enable UART
ENABLE_UART = "1"

# Images
RPI_USE_U_BOOT = "1"
```

## meta-leda-bsp/conf/machine/xenarm64-extra.conf
```bitbake
#@TYPE: Machine
#@NAME: Xen generic-arm64 machine
#@DESCRIPTION: Machine configuration for running a generic-arm64 system under Xen

WKS_FILE = "xenarm64-grub-efi.wks"
MACHINE_FEATURES += "pci"
PREFERRED_RPROVIDER_virtual-grub-bootconf = "rauc-qemu-grubconf"
```
