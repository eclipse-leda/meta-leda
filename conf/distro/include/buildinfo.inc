## meta-leda-components/conf/layer.conf
```bitbake
# /********************************************************************************
# * Copyright (c) 2022 Contributors to the Eclipse Foundation
# *
# * See the NOTICE file(s) distributed with this work for additional
# * information regarding copyright ownership.
# *
# * This program and the accompanying materials are made available under the
# * terms of the Apache License 2.0 which is available at
# * https://www.apache.org/licenses/LICENSE-2.0
# *
# * SPDX-License-Identifier: Apache-2.0
# ********************************************************************************/

# We have a conf and classes directory, add to BBPATH
BBPATH .= ":${LAYERDIR}"

# We have recipes-* directories, add to BBFILES
BBFILES += "${LAYERDIR}/recipes-*/*/*.bb \
            ${LAYERDIR}/recipes-*/*/*.bbappend"

BBFILES_DYNAMIC += " \
    meta-rauc-raspberrypi:${LAYERDIR}/dynamic-layers/raspberry-pi/*.bb \
    meta-rauc-raspberrypi:${LAYERDIR}/dynamic-layers/raspberry-pi/*.bbappend"  

BBFILE_COLLECTIONS += "meta-leda-components"
BBFILE_PATTERN_meta-leda-components := "^${LAYERDIR}/"
BBFILE_PRIORITY_meta-leda-components = "7"

LAYERDEPENDS_meta-leda-components += "core rauc virtualization-layer"

LAYERSERIES_COMPAT_meta-leda-components = "kirkstone"
```

## meta-leda-distro-container/conf/distro/leda-container.conf
```bitbake
# /********************************************************************************
# * Copyright (c) 2022 Contributors to the Eclipse Foundation
# *
# * See the NOTICE file(s) distributed with this work for additional
# * information regarding copyright ownership.
# *
# * This program and the accompanying materials are made available under the
# * terms of the Apache License 2.0 which is available at
# * https://www.apache.org/licenses/LICENSE-2.0
# *
# * SPDX-License-Identifier: Apache-2.0
# ********************************************************************************/

require conf/distro/poky.conf 

DISTRO = "leda-container"
DISTRO_NAME = "Eclipse Leda Container Image"
DISTRO_VERSION = "1.0"
DISTRO_CODENAME = "Miglia"
MAINTAINER = "Eclise Leda Developers <leda-dev@eclipse.org>"

DISTRO_FEATURES = "acl ipv4 ipv6 largefile xattr ${DISTRO_FEATURES_LIBC}"

VIRTUAL-RUNTIME_dev_manager ?= ""
VIRTUAL-RUNTIME_login_manager ?= ""
VIRTUAL-RUNTIME_init_manager ?= ""
VIRTUAL-RUNTIME_initscripts ?= ""
VIRTUAL-RUNTIME_keymaps ?= ""

# Ensure timestamp of rootfs and kernel are updated (non-reproducable-build)
BUILD_REPRODUCIBLE_BINARIES = "0"
REPRODUCIBLE_TIMESTAMP_ROOTFS = ""

# was in local.conf:

# We dont need any kernel in our containers
PREFERRED_PROVIDER_virtual/kernel = "linux-dummy"

# Using smaller standard lib
TCLIBC = "musl"

# Dont install any machine essentials
MACHINE_ESSENTIAL_EXTRA_RDEPENDS = ""

# Skip the following warning during bitbake build, as we're not actually using anything for the target container
#
#   WARNING: You have included the meta-virtualization layer, but 'virtualization' has not been enabled in your DISTRO_FEATURES.
#   Some bbappend files may not take effect. See the meta-virtualization README for details on enabling virtualization support.
#
SKIP_META_VIRT_SANITY_CHECK = "1"

# Remove unneded packages for readonly filesystems,
# such as update-rc.d, base-passwd, shadow update-alternatives, rootfs-bootstrap-install
FORCE_RO_REMOVE = "1"
```

## meta-leda-distro/conf/distro/include/leda-distro-features.inc
```bitbake
# /********************************************************************************
# * Copyright (c) 2022 Contributors to the Eclipse Foundation
# *
# * See the NOTICE file(s) distributed with this work for additional
# * information regarding copyright ownership.
# *
# * This program and the accompanying materials are made available under the
# * terms of the Apache License 2.0 which is available at
# * https://www.apache.org/licenses/LICENSE-2.0
# *
# * SPDX-License-Identifier: Apache-2.0
# ********************************************************************************/

# Enable needed distro features
DISTRO_FEATURES:append = " virtualization"
DISTRO_FEATURES:append = " seccomp"
DISTRO_FEATURES:append = " rauc"
DISTRO_FEATURES:append = " security"
DISTRO_FEATURES:append = " sdv"
DISTRO_FEATURES:append = " ldconfig"

# Enable WiFi
DISTRO_FEATURES:append = " wifi"

# Enable systemd as init process
DISTRO_FEATURES:append = " systemd"
VIRTUAL-RUNTIME_init_manager = "systemd"
DISTRO_FEATURES_BACKFILL_CONSIDERED = "sysvinit"

# Disable unneeded distro features inherited from poky.
DISTRO_FEATURES:remove = "alsa"
DISTRO_FEATURES:remove = "bluetooth"
DISTRO_FEATURES:remove = "cramfs"
DISTRO_FEATURES:remove = "directfb"
DISTRO_FEATURES:remove = "3g"
DISTRO_FEATURES:remove = "opengl"
DISTRO_FEATURES:remove = "wayland"
DISTRO_FEATURES:remove = "x11"
DISTRO_FEATURES:remove = "nfc"
DISTRO_FEATURES:remove = "nfs"
DISTRO_FEATURES:remove = "ext2"
DISTRO_FEATURES:remove = "pcmcia"
DISTRO_FEATURES:remove = "pulseaudio"
DISTRO_FEATURES:remove = "ppp"
DISTRO_FEATURES:remove = "smbfs"
DISTRO_FEATURES:remove = "debuginfod"
DISTRO_FEATURES:remove = "ptest"
```

## meta-leda-distro/conf/distro/include/leda-oss-compliance.inc
```bitbake
# /********************************************************************************
# * Copyright (c) 2022 Contributors to the Eclipse Foundation
# *
# * See the NOTICE file(s) distributed with this work for additional
# * information regarding copyright ownership.
# *
# * This program and the accompanying materials are made available under the
# * terms of the Apache License 2.0 which is available at
# * https://www.apache.org/licenses/LICENSE-2.0
# *
# * SPDX-License-Identifier: Apache-2.0
# ********************************************************************************/

# Package source tarballs to comply with OSS licenses
# Documentation: https://docs.yoctoproject.org/dev-manual/common-tasks.html#providing-the-source-code
# Sources are then in tmp/deploy/sources
INHERIT += "archiver"
ARCHIVER_MODE[src] = "patched"

COPYLEFT_LICENSE_INCLUDE = 'GPL* LGPL*'
COPYLEFT_LICENSE_EXCLUDE = 'CLOSED Proprietary MIT BSD'
COPYLEFT_RECIPE_TYPES = "target"
ARCHIVER_MODE[mirror] = "combined"

# Some licenses require the license text to accompany the binary. You can achieve this by adding the following:
COPY_LIC_MANIFEST = "1"
COPY_LIC_DIRS = "1"
LICENSE_CREATE_PACKAGE = "1"

# Vulnerability Scanning
INHERIT += "cve-check"
```

## meta-leda-distro/conf/distro/include/leda-qemu-settings.inc
```bitbake
# /********************************************************************************
# * Copyright (c) 2022 Contributors to the Eclipse Foundation
# *
# * See the NOTICE file(s) distributed with this work for additional
# * information regarding copyright ownership.
# *
# * This program and the accompanying materials are made available under the
# * terms of the Apache License 2.0 which is available at
# * https://www.apache.org/licenses/LICENSE-2.0
# *
# * SPDX-License-Identifier: Apache-2.0
# ********************************************************************************/

# Increase memory for Kanto Container Management to at least 2GB or more
QB_MEM = "-m 4096"
QB_MEM:qemuarm = "-m 2048"

# No graphical user interface
# QB_OPT_APPEND:append = " -serial mon:stdio -serial null"
QB_OPT_APPEND:append = " -nographic"

# Emulate a CAN-Bus device
QB_OPT_APPEND:append = " -object can-bus,id=canbus0 "
QB_OPT_APPEND:append = " -device kvaser_pci,canbus=canbus0"

QB_DEFAULT_FSTYPE = "ext4"
```

## meta-leda-distro/wic/qemuarm.wks
```
# /********************************************************************************
# * Copyright (c) 2022 Contributors to the Eclipse Foundation
# *
# * See the NOTICE file(s) distributed with this work for additional
# * information regarding copyright ownership.
# *
# * This program and the accompanying materials are made available under the
# * terms of the Apache License 2.0 which is available at
# * https://www.apache.org/licenses/LICENSE-2.0
# *
# * SPDX-License-Identifier: Apache-2.0
# ********************************************************************************/
#
# short-description: Create Qemu disk image
# long-description: Creates a partitioned Qemu disk image for use with the RAUC
# update tool. The partitionging scheme provides:
# * a grub environment partition
# * a rescue partition
# * a bootloader partition with extra space for a shadow copy for atomic bootloader updates
# * two root file system partitions for atomic updates
# * a common data partition

# Boot Loader Configuration, e.g. boot menu
bootloader --ptable gpt

# Boot partition (/dev/vda1)
part --source bootimg-partition --ondisk vda --fstype=vfat --label BOOT --active --align 4096 --size 100 --use-uuid

# Second Bootloader Partition (empty, for future updates)
part --fixed-size 10M --ondisk vda --align 4096 --no-table

# Empty partition (on x86, this is grubenv - we store RAUC Status here as well, /dev/vda2)
part --fixed-size 10M --ondisk vda --align 4096

# Rescue partition (/dev/vda3)
part --fixed-size 150M --source rootfs --rootfs-dir=sdv-image-rescue --ondisk vda --fstype=ext4 --label rescue --align 1024

# SDV Full Image (/dev/vda4)
part --fixed-size 2500M --source rootfs --rootfs-dir=sdv-image-full --ondisk vda --fstype=ext4 --label root_a --align 4096

# SDV Minimal Image (/dev/vda5)
part --fixed-size 2500M --source rootfs --rootfs-dir=sdv-image-minimal  --ondisk vda --fstype=ext4 --label root_b --align 4096

# Data partition for Kanto Container Management (/dev/vda6)
part --fixed-size 4096M --source rootfs --rootfs-dir=sdv-image-data --ondisk vda --fstype=ext4 --label data --align 4096
```

## meta-leda-distro/wic/qemuarm64.wks
```
# /********************************************************************************
# * Copyright (c) 2022 Contributors to the Eclipse Foundation
# *
# * See the NOTICE file(s) distributed with this work for additional
# * information regarding copyright ownership.
# *
# * This program and the accompanying materials are made available under the
# * terms of the Apache License 2.0 which is available at
# * https://www.apache.org/licenses/LICENSE-2.0
# *
# * SPDX-License-Identifier: Apache-2.0
# ********************************************************************************/
#
# short-description: Create Qemu disk image
# long-description: Creates a partitioned Qemu disk image for use with the RAUC
# update tool. The partitionging scheme provides:
# * a grub environment partition
# * a rescue partition
# * a bootloader partition with extra space for a shadow copy for atomic bootloader updates
# * two root file system partitions for atomic updates
# * a common data partition

#
# --source bootimg-partition
#
#part u-boot --source rawcopy --sourceparams="file=u-boot.bin" --ondisk mmcblk0 --no-table --align 1

bootloader --ptable gpt

part --source bootimg-partition --ondisk vda --fstype=vfat --label BOOT --active --align 4096 --size 100 --use-uuid
# Second Bootloader Partition (empty, for future updates)
part --fixed-size 10M --ondisk vda --align 4096 --no-table
# Empty partition (on x86, this is grubenv - we store RAUC Status here as well)
part --fixed-size 10M --ondisk vda --align 4096
part --source rootfs --rootfs-dir=sdv-image-rescue --ondisk vda --fstype=ext4 --label rescue --align 1024
part --extra-space 50M --source rootfs --rootfs-dir=sdv-image-full --ondisk vda --fstype=ext4 --label root_a --align 4096
part --extra-space 50M --source rootfs --rootfs-dir=sdv-image-minimal  --ondisk vda --fstype=ext4 --label root_b --align 4096
part --fixed-size 3072M --source rootfs --rootfs-dir=sdv-image-data --ondisk vda --fstype=ext4 --label data --align 4096
```
