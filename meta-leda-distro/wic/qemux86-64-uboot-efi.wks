## meta-leda-distro/wic/qemux86-64-uboot-efi.wks
```
# /********************************************************************************
# * Copyright (c) 2022 Contributors to the Eclipse Foundation
# *
# * See the NOTICE file(s) distributed with this work for additional
# * information regarding copyright ownership.
# *
# * This program and the accompanying materials are made available under the
# * terms of the Apache License 2.0 which is available at
# * https://www.apache.org/licenses/LICENSE-2.0
# *
# * SPDX-License-Identifier: Apache-2.0
# ********************************************************************************/
#
# short-description: Create Qemu disk image with EFI
# long-description: Creates a partitioned Qemu disk image for use with EFI and the RAUC
# update tool. The partitioning scheme provides:
# * an EFI partition with space for the bootloader and its script and environment
# * a rescue partition
# * two root file system partitions for atomic updates
# * a common data partition

bootloader --ptable gpt

part --fixed-size 50M --source bootimg-partition --ondisk vda --fstype=vfat --label BOOT --active --use-uuid

# Second Bootloader Partition (empty, for future updates)
part --fixed-size 50M --ondisk vda --no-table
# Empty partition
part --fixed-size 10M --ondisk vda

part --source rootfs --rootfs-dir=sdv-image-rescue --ondisk vda --fstype=ext4 --label rescue
part --extra-space 50M --source rootfs --rootfs-dir=sdv-image-full --ondisk vda --fstype=ext4 --label root_a
part --extra-space 50M --source rootfs --rootfs-dir=sdv-image-minimal --ondisk vda --fstype=ext4 --label root_b
part --fixed-size 3072M --source rootfs --rootfs-dir=sdv-image-data --ondisk vda --fstype=ext4 --label data
```

## meta-leda-distro/wic/qemux86-grub-efi.wks
```
# /********************************************************************************
# * Copyright (c) 2022 Contributors to the Eclipse Foundation
# *
# * See the NOTICE file(s) distributed with this work for additional
# * information regarding copyright ownership.
# *
# * This program and the accompanying materials are made available under the
# * terms of the Apache License 2.0 which is available at
# * https://www.apache.org/licenses/LICENSE-2.0
# *
# * SPDX-License-Identifier: Apache-2.0
# ********************************************************************************/
#
# short-description: Create Qemu disk image
# long-description: Creates a partitioned Qemu disk image for use with the RAUC
# update tool. The partitionging scheme provides:
# * a grub environment partition
# * a rescue partition
# * a bootloader partition with extra space for a shadow copy for atomic bootloader updates
# * two root file system partitions for atomic updates
# * a common data partition

# Set the partition tabnle to GPT
bootloader --ptable gpt

# First Bootloader Partition
part --fixed-size 50M --source rawcopy --sourceparams="file=efi-boot.vfat" --fstype=vfat --ondisk vda --label boot --active

# Second Bootloader Partition (empty, for future updates)
part --fixed-size 50M --ondisk vda --no-table

# GRUB environment to store info about retries, mounted for showcase
part --fixed-size 10M --source rawcopy --sourceparams="file=grubenv.vfat" --fstype=vfat --ondisk vda --label grubenv

# A rescue partition as fallback ("Factory Reset"), mounted for showcase
part --fixed-size 150M --source rootfs --rootfs-dir=sdv-image-rescue --ondisk vda --fstype=ext4 --label rescue --fsoptions "ro"

# First Root Partition (active, pre-installed), mounted readonly to show that root fs can be readonly
# and all container-apps in cluster are contained on /data
part --fixed-size 2500M --source rootfs --rootfs-dir=sdv-image-full --ondisk vda --fstype=ext4 --label root_a

# Second Root Partition (empty, not mounted) to show the self-update mechanism
part --fixed-size 2500M --source rootfs --rootfs-dir=sdv-image-minimal --ondisk vda --fstype=ext4 --label root_b

# The data partition to store Kubernetes Cluster state (e.g. containerized apps)
# Last partition, so that it can be grown (eg on Raspi to full SD-Card capacitiy, on qemu by extending the qcow2 disk image file)
part --fixed-size 4096M --source rootfs --rootfs-dir=sdv-image-data --ondisk vda --fstype=ext4 --label data
```

## meta-sdv-bsp/conf/layer.conf
```bitbake
# /********************************************************************************
# * Copyright (c) 2022 Contributors to the Eclipse Foundation
# *
# * See the NOTICE file(s) distributed with this work for additional
# * information regarding copyright ownership.
# *
# * This program and the accompanying materials are made available under the
# * terms of the Apache License 2.0 which is available at
# * https://www.apache.org/licenses/LICENSE-2.0
# *
# * SPDX-License-Identifier: Apache-2.0
# ********************************************************************************/

# We have a conf and classes directory, add to BBPATH
BBPATH .= ":${LAYERDIR}"

# We have recipes-* directories, add to BBFILES
BBFILES += "${LAYERDIR}/recipes-*/*/*.bb \
            ${LAYERDIR}/recipes-*/*/*.bbappend"

BBFILES_DYNAMIC += " \
    meta-rauc-raspberrypi:${LAYERDIR}/dynamic-layers/raspberry-pi/*.bb \
    meta-rauc-raspberrypi:${LAYERDIR}/dynamic-layers/raspberry-pi/*.bbappend"  

BBFILE_COLLECTIONS += "meta-sdv-bsp"
BBFILE_PATTERN_meta-sdv-bsp := "^${LAYERDIR}/"
BBFILE_PRIORITY_meta-sdv-bsp = "7"
LAYERDEPENDS_meta-sdv-bsp += "meta-sdv-components"
LAYERSERIES_COMPAT_meta-sdv-bsp = "honister"
```

## wic/qemuarm-grub.wks
```
# /********************************************************************************
# * Copyright (c) 2022 Contributors to the Eclipse Foundation
# *
# * See the NOTICE file(s) distributed with this work for additional
# * information regarding copyright ownership.
# *
# * This program and the accompanying materials are made available under the
# * terms of the Apache License 2.0 which is available at
# * https://www.apache.org/licenses/LICENSE-2.0
# *
# * SPDX-License-Identifier: Apache-2.0
# ********************************************************************************/
#
# short-description: Create Qemu disk image
# long-description: Creates a partitioned Qemu disk image for use with the RAUC
# update tool. The partitionging scheme provides:
# * a grub environment partition
# * a rescue partition
# * a bootloader partition with extra space for a shadow copy for atomic bootloader updates
# * two root file system partitions for atomic updates
# * a common data partition

bootloader --ptable gpt
part --fixed-size 50M --fstype=vfat --ondisk vda --label boot --active --align 4096
part --fixed-size 50M --ondisk vda --align 4096 --no-table
part --fixed-size 10M --fstype=vfat --ondisk vda --label grubenv --align 1024
part /rescue --size 500M --ondisk vda --fstype=ext4 --label rescue --align 1024
part / --source rootfs --ondisk vda --fstype=ext4 --label root_a --align 4096
part / --size 500M --ondisk vda --fstype=ext4 --label root_b --align 4096
part /data --fixed-size 50M --ondisk vda --fstype=ext4 --label data --align 4096

#part --fixed-size 50M --source rawcopy --sourceparams="file=efi-boot.vfat" --fstype=vfat --ondisk sda --label boot --active --align 4096
#part --fixed-size 50M --ondisk sda --align 4096 --no-table
#part --fixed-size 10M --source rawcopy --sourceparams="file=grubenv.vfat" --fstype=vfat --ondisk sda --label grubenv --align 1024
#part /rescue --source rootfs --ondisk sda --fstype=ext4 --label rescue --align 1024
#part / --source rootfs --ondisk sda --fstype=ext4 --label root_b --align 4096
```
